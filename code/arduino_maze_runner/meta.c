// NOTE: From project directory:
// tcc -run meta.c

#define BASE_WINDOWS_H
#include <Windows.h>

#define BASE_IMPLEMENTATION
#include "../base.h"
#define STB_IMAGE_IMPLEMENTATION
#define STBI_NO_SIMD
#include "../third_party/stb_image.h"

#include "meta.h"

#define PrintSep(l) \
  if (i > 0) {                                          \
    str8_list_push(arena, &(l), Str8Lit(", "));     \
    if (i % VALUES_PER_LINE == 0) {                     \
      str8_list_push(arena, &(l), Str8Lit("\n\t")); \
    }                                                   \
  }                                                     \

global u8 *PGMAccessU8_str  = "#if OS_WINDOWS\n# define PGMAccessU8(addr)  ((u8)(*(addr)))\n#else\n# define PGMAccessU8(addr)  pgm_read_byte_near(addr)\n#endif\n\n";
global u8 *PGMAccessU16_str = "#if OS_WINDOWS\n# define PGMAccessU16(addr) ((u16)(*(addr)))\n#else\n# define PGMAccessU16(addr) pgm_read_word_near(addr)\n#endif\n\n";

int
main (void) {
  Arena *arena = arena_alloc_default();
  printf("Generating trig lookup tables...\n");
  printf("Using a scaling factor of %d and %d-bit angle resolution.\n", TRIG_SCALING_FACTOR, TRIG_INDEX_BITS);
  printf("Screen resolution (%d, %d) | FOV: %f degrees | Raycast resolution: %d\n", RESOLUTION_WIDTH, RESOLUTION_HEIGHT, RAYCAST_FOV * RAD2DEG, RAYCAST_RESOLUTION);

  u8 current_directory[PATH_MAX];
  u32 chars_written = GetCurrentDirectory(PATH_MAX, current_directory);
  Assert(chars_written > 0);
  Str8 base_path = Str8CStr(current_directory);
  Str8_List path = {0};
  str8_list_push(arena, &path, base_path);
  str8_list_push(arena, &path, Str8Lit("/generated"));
  Str8 generated_path = str8_list_join(arena, path, NULL);

  bool directory_create_result = CreateDirectory(str8_to_cstr(arena, generated_path), NULL);
  if (!directory_create_result) {
    if (GetLastError() != ERROR_ALREADY_EXISTS) {
      printf("Unable to create output directory!\n");
      return 1;
    }
  }

  Str8_List trig_lookup_builder = {0};
  str8_list_pushf(arena, &trig_lookup_builder, "// NOTE: Generated by %.*s\\%s\n\n", Str8Expand(base_path), __FILE__);

  // NOTE: Bake constants
  u16 pixels_per_raycast = RESOLUTION_WIDTH / RAYCAST_RESOLUTION;
  str8_list_pushf(arena, &trig_lookup_builder, "#define PIXELS_PER_RAYCAST %d\n", pixels_per_raycast);
  f64 camera_focal_length = (RESOLUTION_WIDTH/2.0) / tan(RAYCAST_FOV/2.0);
  str8_list_pushf(arena, &trig_lookup_builder, "#define CAMERA_FOCAL_LENGTH %f_fx32\n\n", camera_focal_length);

  // NOTE: Access macros
  str8_list_push(arena, &trig_lookup_builder, Str8CStr(PGMAccessU8_str));
  str8_list_push(arena, &trig_lookup_builder, Str8CStr(PGMAccessU16_str));

  {
    Str8_List sin_lut = {0};
    str8_list_push(arena, &sin_lut, Str8Lit("global const PROGMEM s16 sin_lookup[] = {\n\t"));
    f64 rad_step = (M_PI / 2.0) / TRIG_INDEX_MAX;
    for (int i = 0; i <= TRIG_INDEX_MAX + 1; ++i) {
      PrintSep(sin_lut);
      s16 value = (s16)lround(sin(i * rad_step) * TRIG_SCALING_FACTOR);
      str8_list_pushf(arena, &sin_lut, "%d", value);
    }
    str8_list_push(arena, &sin_lut, Str8Lit("\n};"));
    str8_list_concat(&trig_lookup_builder, &sin_lut);

    str8_list_push(arena, &trig_lookup_builder, Str8Lit("\n\n"));

    // TODO: This could be made smaller
    Str8_List angle_lut = {0};
    str8_list_push(arena, &angle_lut, Str8Lit("global const PROGMEM u16 ray_angle_lookup[] = {\n\t"));
    for (int i = 0; i < RAYCAST_RESOLUTION; ++i) {
      PrintSep(angle_lut);
      f64 proj_x = ((i * pixels_per_raycast) + pixels_per_raycast/2.0) - RESOLUTION_WIDTH/2.0;
      u16 value  = (u16)lround(atan2(proj_x, camera_focal_length) * ((65536.0)/(2.0*M_PI)));
      str8_list_pushf(arena, &angle_lut, "%u", value);
    }
    str8_list_push(arena, &angle_lut, Str8Lit("\n};"));
    str8_list_concat(&trig_lookup_builder, &angle_lut);
  }

  Str8 trig_lookup_file = str8_list_join(arena, trig_lookup_builder, NULL);

  str8_list_push(arena, &path, Str8Lit("/trig_lookup.cpp"));
  Str8 file_path = str8_list_join(arena, path, NULL);
  HANDLE output = CreateFile(str8_to_cstr(arena, file_path), GENERIC_WRITE, 0, NULL, CREATE_ALWAYS, FILE_ATTRIBUTE_NORMAL, NULL);
  if (output == INVALID_HANDLE_VALUE) {
    printf("Unable to create output file(s)!\n");
    return 1;
  }
  DWORD bytes_written;
  bool success = WriteFile(output, trig_lookup_file.str, trig_lookup_file.count, &bytes_written, NULL);
  if (!success || bytes_written != trig_lookup_file.count) {
    printf("Unable to write to output file(s)!\n");
    return 1;
  }

  return 0;
}